// Code generated by Claude 3.7 Sonet (ClaudeAI), tweaked by Pelinito (me) to design the beat sequence
// I asked ChatGPT the beat sequence


// Arduino BPM-Based LED Sequencer
// Multiple LED patterns synced to the same BPM

// === LED Configuration ===
const int numLeds = 10;
const int ledPins[numLeds] = {2, 3, 4, 5, 6, 7, 8, 9, 10, 11};

// === BPM Settings ===
const int songBPM = 121.3;  
const unsigned long beatInterval = 60000 / songBPM;  // Milliseconds per beat

// === Pattern Settings ===
// Each LED can have its own rhythm pattern
// 1 = on, 0 = off for each beat position
const int patternLength = 8;  // Number of beats in the pattern
bool ledPatterns[numLeds][patternLength] = {
  
  // Skeletons - Guitar line (blue LEDs)
  // {1, 0, 0, 1, 0, 1, 0, 1} - 4 beats in 8 beats assigned to each LED, 
  // syncs with Vocals on the first beats in 4 to enhance the effect

  {1, 0, 0, 0, 1, 0, 0, 0}, // Skeleton 1 - LED 1 - D2
  {1, 0, 0, 1, 1, 0, 0, 0}, // Skeleton 2 - LED 2 - D3
  {1, 0, 0, 0, 1, 1, 0, 0}, // Skeleton 3 - LED 3 - D4
  {1, 0, 0, 0, 1, 0, 0, 1}, // Skeleton 4 - LED 4 - D5

  // Sync Swimmers - Synth Pattern (green LEDs)
  // {1, 1, 0, 0, 1, 1, 0, 0} - Again 4 beats in total assigned to each LED
  {1, 0, 0, 0, 0, 0, 0, 0}, // Swimmer 1 - LED 1 - D6
  {0, 1, 0, 0, 0, 0, 0, 0}, // Swimmer 2 - LED 2 - D7
  {0, 0, 0, 0, 1, 0, 0, 0}, // Swimmer 3 - LED 3 - D8
  {0, 0, 0, 0, 0, 1, 0, 0}, // Swimmer 4 - LED 4 - D9

  // Robots - Vocals "Around the world" (yellow LED)
  {1, 0, 0, 0, 1, 0, 0, 0}, // Vocals - one LED only - D10


  // Mummies - Bass Line (red LED)
  {1, 0, 1, 0, 1, 0, 1, 0} // Bass - one LED only - D11



  // {1, 0, 1, 0, 1, 0, 1, 0},  // Bass Line - Skeletons / mummies
  // {1, 1, 0, 0, 1, 1, 0, 0},  // Vocal Line - Athletes
  // {1, 0, 1, 1, 0, 1, 0, 0},  // Synthesizer - Robots
  // {0, 1, 0, 1, 0, 1, 0, 1}   // Hi-Hat, cymbals
};

// === Timing Variables ===
unsigned long previousBeatMillis = 0;
int currentBeat = 0;

void setup() {
  // Initialize LED pins
  for (int i = 0; i < numLeds; i++) {
    pinMode(ledPins[i], OUTPUT);
    digitalWrite(ledPins[i], LOW);
  }
  
  Serial.begin(9600);
  Serial.print("BPM sequencer started at ");
  Serial.print(songBPM);
  Serial.println(" BPM");
}

void loop() {
  unsigned long currentMillis = millis();
  
  // Check if it's time for the next beat
  if (currentMillis - previousBeatMillis >= beatInterval) {
    previousBeatMillis = currentMillis;
    
    Serial.print("Beat: ");
    Serial.println(currentBeat + 1);  // Display beat number (1-8 instead of 0-7)
    
    // Update all LEDs based on their patterns for the current beat
    for (int i = 0; i < numLeds; i++) {
      digitalWrite(ledPins[i], ledPatterns[i][currentBeat] ? HIGH : LOW);
    }
    
    // Move to next beat
    currentBeat = (currentBeat + 1) % patternLength;
  }
  
  // You can add other non-blocking code here
  // This will run continuously while waiting for the next beat
}